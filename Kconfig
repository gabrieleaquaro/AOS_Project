## Kconfig
```kconfig
config BOSP_SAMPLES_CPP
bool
default n

config BOSP_SAMPLES_OPENCL
bool
default n

config BOSP_SAMPLES_OPENCV
bool
default n

config BOSP_SAMPLES_PYTHON
bool
default n

################################################################################
#     C++ sample applications
################################################################################

menu "C++"

source "samples/cpp/Kconfig"

endmenu

################################################################################
#     OpenCL sample applications
################################################################################

menu "OpenCL"

source "samples/opencl/Kconfig"

endmenu

################################################################################
#     OpenCV sample applications
################################################################################

menu "OpenCV"

source "samples/opencv/Kconfig"

endmenu

################################################################################
#     Python sample applications
################################################################################

menu "Python"

source "samples/python/Kconfig"

endmenu
```

## cpp/FFT/Kconfig
```kconfig
config SAMPLES_CPP_FFT
  bool "FFT"
  default n
  select BOSP_SAMPLES_CPP
  ---help---
  Build the FFT application.
  
  Insert here a description of this application.

  If unsure, say No to this option.
```

## cpp/HelloCPP/Kconfig
```kconfig
config SAMPLES_CPP_HELLOCPP
  bool "HelloCPP"
  default n
  select BOSP_SAMPLES_CPP
  ---help---
  Build the HelloCPP application.
  
  Insert here a description of this application.

  If unsure, say No to this option.
```

## cpp/Kconfig
```kconfig
# Selection of generic CPP sample applications
source samples/cpp/HelloCPP/Kconfig
source samples/cpp/FFT/Kconfig
```

## opencl/Kconfig
```kconfig
source samples/opencl/backprop/Kconfig
source samples/opencl/heartwall/Kconfig
source samples/opencl/hellocl/Kconfig
source samples/opencl/hotspot/Kconfig
```

## opencv/Kconfig
```kconfig
source samples/opencv/background_learning/Kconfig
source samples/opencv/facedetect/Kconfig
source samples/opencv/hough_circles/Kconfig
source samples/opencv/edge_detector/Kconfig
```

## opencv/edge_detector/Kconfig
```kconfig
config SAMPLES_OPENCV_EDGEDETECTOR
  bool "Canny Edge Detector"
  default n
  select BOSP_SAMPLES_OPENCV
  ---help---
  Build the Canny Edge Detector application.
  
  If unsure, say No to this option.
```

## python/PySample/Kconfig
```kconfig
config SAMPLES_PYTHON_PYSAMPLE
  bool "PySample"
  default n
  select BOSP_SAMPLES_PYTHON
  select BBQUE_BINDINGS_PYTHON
  ---help---
  Build the PySample Python-AEM application. 
```
